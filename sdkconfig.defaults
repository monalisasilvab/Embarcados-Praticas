## sdkconfig.defaults
```kconfig
# Configurações WiFi
CONFIG_ESP_WIFI_SSID=""
CONFIG_ESP_WIFI_PASSWORD=""

# Configurações de log
CONFIG_LOG_DEFAULT_LEVEL_INFO=y
CONFIG_LOG_DEFAULT_LEVEL=3

# Configurações de partição
CONFIG_PARTITION_TABLE_SINGLE_APP=y

# Configurações FreeRTOS
CONFIG_FREERTOS_HZ=1000

# Configurações LWIP
CONFIG_LWIP_SO_REUSE=y
CONFIG_LWIP_SO_REUSE_RXTOALL=y

# Configurações MQTT
CONFIG_MQTT_PROTOCOL_311=y
CONFIG_MQTT_TRANSPORT_SSL=y
CONFIG_MQTT_TRANSPORT_WEBSOCKET=y

# Configurações ESP-TLS
CONFIG_ESP_TLS_USING_MBEDTLS=y
CONFIG_MBEDTLS_CERTIFICATE_BUNDLE=y
CONFIG_MBEDTLS_CERTIFICATE_BUNDLE_DEFAULT_FULL=y

# Tamanho da pilha principal
CONFIG_ESP_MAIN_TASK_STACK_SIZE=8192
```
